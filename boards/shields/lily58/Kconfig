## boards/shields/lily58/Kconfig
```kconfig
menu "Lily58 Dongle Configuration"
    depends on SHIELD_LILY58_DONGLE

    config LILY58_DONGLE
        bool "Enable Lily58 Dongle"
        default y
        help
            Enable Lily58 Dongle configuration

endmenu
```

## boards/shields/lily58/Kconfig.defconfig
```kconfig
if SHIELD_LILY58_DONGLE

# Max 16 characters in keyboard name
config ZMK_KEYBOARD_NAME
    default "Lily58 Dongle"

config ZMK_SPLIT_ROLE_CENTRAL
    default y

config ZMK_SPLIT
    default y

# Lily58 has 2 halves
config ZMK_SPLIT_BLE_CENTRAL_PERIPHERALS
    default 2

config BT_MAX_CONN
    default 7

config BT_MAX_PAIRED
    default 7

config ZMK_USB
    default y

# Отключаем драйвер kscan для донгла
config ZMK_KSCAN
    default n

# Отключаем матрицу для донгла
config ZMK_MATRIX_TRANSFORM
    default n

endif # SHIELD_LILY58_DONGLE
```

## west.yml
```yaml
manifest:
  remotes:
    - name: zmkfirmware
      url-base: https://github.com/zmkfirmware
  projects:
    - name: zmk
      remote: zmkfirmware
      revision: v3.2.0  # Актуальная стабильная версия на момент 2024 года
      import: app/west.yml
  self:
    path: config
```
